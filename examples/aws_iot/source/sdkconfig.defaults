## examples/aws_iot/source/sdkconfig.defaults
```kconfig
# Enable custom partition table
CONFIG_PARTITION_TABLE_CUSTOM=y
CONFIG_PARTITION_TABLE_CUSTOM_FILENAME="partitions.csv"
CONFIG_PARTITION_TABLE_FILENAME="partitions.csv"

# Include AWS_IOT_SDK
CONFIG_AWS_IOT_SDK=y
```

## examples/gpio/main/Kconfig.projbuild
```kconfig
menu "Example Configuration"

    config BUTTON_GPIO
        int "Button GPIO Number"
        default 0
        help
            GPIO number for the button.

    config LED_GPIO
        int "LED GPIO Number"
        default 2
        help
            GPIO number fot the LED.

endmenu
```

## examples/local_ota/main/Kconfig.projbuild
```kconfig
menu "Example Configuration"

    config ESP_WIFI_SSID
        string "WiFi SSID"
        default "myssid"
        help
            SSID (network name) for the example to connect to.

    config ESP_WIFI_PASSWORD
        string "WiFi Password"
        default "mypassword"
        help
            WiFi password (WPA or WPA2) for the example to use.

    config OTA_IP
        string "IP Address"
        default "10.10.0.2"
        help
            IP Address of the device hosting the OTA firmware binary

    config OTA_PORT
        string "OTA Port"
        default "8080"
        help
            Port of hosting of OTA firmware binary

    config OTA_FILENAME
        string "OTA File Name"
        default "new-firmware.bin"
        help
            File name of the new OTA firmware binary to be downloaded (has to match the filename being hosted by the host)

endmenu
```

## examples/phx_client/main/Kconfig.projbuild
```kconfig
menu "Example Configuration"

    config ESP_WIFI_SSID
        string "WiFi SSID"
        default "myssid"
        help
            SSID (network name) for the example to connect to.

    config ESP_WIFI_PASSWORD
        string "WiFi Password"
        default "mypassword"
        help
            WiFi password (WPA or WPA2) for the example to use.

    config PHOENIX_WEBSOCKET_URL
        string "Websocket URL"
        default "wss://echo.websocket.org"
        help
            URL to Websocket

endmenu
```

## examples/wifi_softap/main/Kconfig.projbuild
```kconfig
menu "Example Configuration"

    config USE_CUSTOM_SSID
        bool "Use custom SSID"
        default n
        help
            If this config item is set, then the user can set custom softAP SSID.
            If false, the default SSID is "IoT-<12-digit-mac-address>".

    config ESP_WIFI_SSID
        depends on USE_CUSTOM_SSID
        string "WiFi SSID"
        default "myssid"
        help
            SSID (network name) for the example to connect to.

    config ESP_WIFI_PASSWORD
        string "WiFi Password"
        default "mypassword"
        help
            WiFi password (WPA or WPA2) for the example to use.
    config ESP_WIFI_CHANNEL
        int "WiFi Channel"
        range 1 13
        default 1
        help
            WiFi channel (network channel) for the example to use.

    config ESP_MAX_STA_CONN
        int "Maximal STA connections"
        default 4
        help
            Max number of the STA connects to AP.
endmenu
```
